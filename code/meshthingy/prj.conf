## CMakeLists.txt
```
# SPDX-License-Identifier: Apache-2.0

cmake_minimum_required(VERSION 3.20.0)
set(QEMU_EXTRA_FLAGS -s)

find_package(Zephyr REQUIRED HINTS $ENV{ZEPHYR_BASE})
project(meshthingy)

target_sources(app PRIVATE src/main.c)
target_sources(app PRIVATE src/board.c)
target_sources(app PRIVATE src/scu_sensors.c)
target_sources(app PRIVATE src/battery.c)


if(NODE_ADDR)
  zephyr_compile_definitions(NODE_ADDR=${NODE_ADDR})
endif()
```

## prj.conf
```kconfig
CONFIG_SYSTEM_WORKQUEUE_STACK_SIZE=4096

CONFIG_BT_SETTINGS=y
CONFIG_FLASH=y
CONFIG_FLASH_MAP=y
CONFIG_NVS=y
CONFIG_SETTINGS=y
CONFIG_HWINFO=y

CONFIG_ADC=y
CONFIG_GPIO=y
CONFIG_STDOUT_CONSOLE=y
CONFIG_I2C=y
CONFIG_SENSOR=y
CONFIG_HTS221=y
CONFIG_LPS22HB=y
CONFIG_LIS2DH=y
CONFIG_CCS811=y

CONFIG_BT_OBSERVER=y
CONFIG_BT_CTLR_DUP_FILTER_LEN=0
CONFIG_BT_CTLR_LE_ENC=n
CONFIG_BT_DATA_LEN_UPDATE=n
CONFIG_BT_PHY_UPDATE=n
CONFIG_BT_CTLR_CHAN_SEL_2=n
CONFIG_BT_CTLR_MIN_USED_CHAN=n
CONFIG_BT_CTLR_PRIVACY=n

CONFIG_BT_PERIPHERAL=y

CONFIG_BT=y
CONFIG_BT_TINYCRYPT_ECC=y
CONFIG_BT_L2CAP_TX_BUF_COUNT=5

CONFIG_BT_MESH=y
# CONFIG_BT_MESH_MODEL_EXTENSIONS=y
CONFIG_BT_MESH_RELAY=y
# CONFIG_BT_MESH_FRIEND=y
# CONFIG_BT_MESH_PB_GATT=y
# CONFIG_BT_MESH_PB_ADV=y
# CONFIG_BT_MESH_GATT_PROXY=y
CONFIG_BT_MESH_SUBNET_COUNT=1
CONFIG_BT_MESH_APP_KEY_COUNT=1
CONFIG_BT_MESH_MODEL_GROUP_COUNT=2
CONFIG_BT_MESH_ADV_BUF_COUNT=10
CONFIG_BT_MESH_LABEL_COUNT=0
CONFIG_BT_MESH_PB_ADV=n
CONFIG_BT_MESH_CFG_CLI=y
CONFIG_BT_MESH_LOOPBACK_BUFS=8

#CONFIG_BT_MESH_LOW_POWER=y
#CONFIG_BT_MESH_LPN_SCAN_LATENCY=30
#CONFIG_BT_MESH_LPN_RECV_DELAY=40
#CONFIG_BT_MESH_LPN_POLL_TIMEOUT=300

# CONFIG_BT_MESH_SUBNET_COUNT=2
# CONFIG_BT_MESH_APP_KEY_COUNT=2
# CONFIG_BT_MESH_MODEL_GROUP_COUNT=2
# CONFIG_BT_MESH_LABEL_COUNT=3

CONFIG_BT_DEBUG_LOG=n

CONFIG_BT_MESH_DEBUG=y
CONFIG_BT_MESH_DEBUG_MODEL=y

#-----------------------------RTT_CONFIG--------------------------------------
CONFIG_USE_SEGGER_RTT=y

CONFIG_RTT_CONSOLE=y
CONFIG_UART_CONSOLE=n
#-----------------------------------------------------------------------------

CONFIG_CBPRINTF_FP_SUPPORT=y

#CONFIG_NEWLIB_LIBC=y

CONFIG_BT_MESH_SEQ_STORE_RATE=1
```

## app.overlay
```dts
&pwm0 {
  status = "okay";
  ch0-pin = <0x1b>; 
};
/ {
    aliases {
        led1 = &led1;
        led2 = &led2;
        vddpwr = &vdd_pwr;
        ccspwr = &ccs_pwr;
    };
};
```

## src/main.c
```c
/* main.c - Application main entry point */

/*
 * Copyright (c) 2017 Intel Corporation
 *
 * SPDX-License-Identifier: Apache-2.0
 */

#include <sys/printk.h>

#include <stdio.h>
#include <stdlib.h>

#include <settings/settings.h>
#include <devicetree.h>
#include <device.h>
#include <drivers/gpio.h>
#include <drivers/hwinfo.h>
#include <sys/byteorder.h>

#include <bluetooth/bluetooth.h>
#include <bluetooth/mesh.h>

#include <zephyr.h>
#include "battery.h"
#include "board.h"
#include "scu_sensors.h"
#include <math.h>

#define MY_STACK_SIZE 1024
#define MY_PRIORITY 5

// Time for sleep mode
uint32_t timer = 0;

/**
 * @brief timer that increase every second
 * 
 * @param argv thread arguments
**/
void timer_func(void* argv) 
{    
    // Increase time by 1 second
    while(1) {
        k_msleep(1);
        timer++;
    }
}

K_THREAD_DEFINE(timer_thread, MY_STACK_SIZE,
                timer_func, NULL, NULL, NULL,
                MY_PRIORITY, 0, 0);

#define LED0_NODE DT_ALIAS(led0)
#define LED1_NODE DT_ALIAS(led1)
#define LED2_NODE DT_ALIAS(led2)

// LED device tree spec
static const struct gpio_dt_spec red_led = GPIO_DT_SPEC_GET(LED0_NODE, gpios);
static const struct gpio_dt_spec green_led = GPIO_DT_SPEC_GET(LED1_NODE, gpios);
static const struct gpio_dt_spec blue_led = GPIO_DT_SPEC_GET(LED2_NODE, gpios);				

/** A discharge curve specific to the power source. */
static const struct battery_level_point levels[] = {
#if DT_NODE_HAS_PROP(DT_INST(0, voltage_divider), io_channels)
	/* "Curve" here eyeballed from captured data for the [Adafruit
	 * 3.7v 2000 mAh](https://www.adafruit.com/product/2011) LIPO
	 * under full load that started with a charge of 3.96 V and
	 * dropped about linearly to 3.58 V over 15 hours.  It then
	 * dropped rapidly to 3.10 V over one hour, at which point it
	 * stopped transmitting.
	 *
	 * Based on eyeball comparisons we'll say that 15/16 of life
	 * goes between 3.95 and 3.55 V, and 1/16 goes between 3.55 V
	 * and 3.1 V.
	 */

	{ 10000, 3950 },
	{ 625, 3550 },
	{ 0, 3100 },
#else
	/* Linear from maximum voltage to minimum voltage. */
	{ 10000, 3600 },
	{ 0, 1700 },
#endif
};

#define PREAMBLE 0xAF
#define REQUEST 0xFF
#define PRESSURE 0x01
#define ECO2 0x02
#define TEMPERATURE 0x03
#define HUMIDITY 0x04
#define VOC 0x05
#define PM1_0 0x06
#define PM2_5 0x07
#define PM4_0 0x08
#define PM10_0 0x09
#define NOX 0x0a
#define BATTERY 0x0b
#define RANDOM_8 (k_uptime_get_32() & 0xFF)

#define NODE_ADDR 0x0003

#define OP_ONOFF_GET       BT_MESH_MODEL_OP_2(0x82, 0x01)
#define OP_ONOFF_SET       BT_MESH_MODEL_OP_2(0x82, 0x02)
#define OP_ONOFF_SET_UNACK BT_MESH_MODEL_OP_2(0x82, 0x03)
#define OP_ONOFF_STATUS    BT_MESH_MODEL_OP_2(0x82, 0x04)

//Message OP-Codes (7.1-Message Summary table - MeshModel) 
#define BT_MESH_MODEL_OP_SENSOR_GET BT_MESH_MODEL_OP_2(0x82, 0x31)
#define BT_MESH_MODEL_OP_SENSOR_STATUS BT_MESH_MODEL_OP_2(0x00, 0x52)
#define BT_MESH_MODEL_OP_SENSOR_COLUMN_GET BT_MESH_MODEL_OP_2(0x82, 0x32)
#define BT_MESH_MODEL_OP_SENSOR_COLUMN_STATUS BT_MESH_MODEL_OP_2(0x00, 0x53)
#define BT_MESH_MODEL_OP_SENSOR_SERIES_GET BT_MESH_MODEL_OP_2(0x82, 0x33)
#define BT_MESH_MODEL_OP_SENSOR_SERIES_STATUS BT_MESH_MODEL_OP_2(0x00, 0x54)

#ifndef CONFIG_BT_SETTINGSn
#define CONFIG_BT_MESH_SEQ_STORE_RATE 0
#endif

static const uint8_t net_key[16] = {
	0xb2, 0xf1, 0xc5, 0x33, 0xeb, 0x04, 0x82, 0x35,
	0xa2, 0xe3, 0x71, 0x5c, 0xe0, 0x68, 0xf0, 0x7e
};
static const uint8_t dev_key[16] = {
	0xbd, 0x89, 0xf0, 0xfb, 0x05, 0xcb, 0xe7, 0x45, 
	0xce, 0xa7, 0xf2, 0x30, 0x20, 0x73, 0x77, 0xe3, 
};
static const uint8_t app_key[16] = {
	0xd1, 0xe8, 0xda, 0x61, 0x16, 0x60, 0x42, 0x06, 
	0x74, 0x14, 0xbd, 0x49, 0xed, 0x6d, 0x05, 0xcb, 
};

static const uint16_t net_idx;
static const uint16_t app_idx;
static uint32_t iv_index;
static uint8_t flags;
static uint16_t addr = NODE_ADDR;

static int send_sensor_data(struct bt_mesh_model *model, struct bt_mesh_msg_ctx *ctx, uint8_t device, float data);

static void attention_on(struct bt_mesh_model *mod)
{
	board_led_set(true);
}

static void attention_off(struct bt_mesh_model *mod)
{
	board_led_set(false);
}

static const struct bt_mesh_health_srv_cb health_cb = {
	.attn_on = attention_on,
	.attn_off = attention_off,
};

static struct bt_mesh_health_srv health_srv = {
	.cb = &health_cb,
};

BT_MESH_HEALTH_PUB_DEFINE(health_pub, 0);

static struct {
	uint8_t tid;
	uint16_t src;
} onoff;

void sensor_get(struct bt_mesh_model *model, struct bt_mesh_msg_ctx *ctx, struct net_buf_simple *buf)
{
	printk("sensor_get()\n");

	printk("Got ");
	for (int i = 0; i < buf->len; i++) {
		printk("%02x ", buf->data[i]);
	}
	printk("\n");
	
	uint8_t tid = net_buf_simple_pull_u8(buf);
	uint8_t random = net_buf_simple_pull_u8(buf);
	uint8_t address = net_buf_simple_pull_u8(buf);
	uint8_t preamble = net_buf_simple_pull_u8(buf);
	uint8_t type = net_buf_simple_pull_u8(buf);
	uint8_t length = net_buf_simple_pull_u8(buf);
	timer = net_buf_simple_pull_le32(buf);
	uint8_t device = net_buf_simple_pull_u8(buf);
	printk("%02x %02x\n", onoff.src, ctx->addr);
	if (tid == onoff.tid && onoff.src == ctx->addr) {
		/* Duplicate */
		return 0;
	}
	board_led_set(true);
	k_sleep(K_MSEC(50));
	board_led_set(false);
	//printk("%02x %02x %02x %02x %02x %08x\n", tid, address, preamble, type, length, data);

	if (preamble == PREAMBLE) {
		printk("correct preamble\n");
		// Checks which device id was receieved
		switch(device) {
			case 1:
				send_sensor_data(model, ctx, device, scu_lps22hb_read());
				break;
			case 2:
				send_sensor_data(model, ctx, device, scu_ccs811_read_eco2());
				break;
			case 3:
				send_sensor_data(model, ctx, device, scu_hts221_read_temp());
				break;
			case 4:
				send_sensor_data(model, ctx, device, scu_hts221_read_hum());
				break;
			case 5:
				send_sensor_data(model, ctx, device, scu_ccs811_read_voc());
				break;
			case BATTERY:;
				int batt_mV = battery_sample();

				if (batt_mV < 0) {
					printk("Failed to read battery voltage: %d\n",
						batt_mV);
					break;
				}

				send_sensor_data(model, ctx, device, (float) batt_mV);
				
				if (batt_mV < 3600) {
					printk("low batt\n");
					board_led_set(true);
					//gpio_pin_set_dt(&red_led, 0);	
					gpio_pin_set_dt(&green_led, 1);	
					gpio_pin_set_dt(&blue_led, 1);
				} else if (batt_mV > 3800) {
					printk("high batt\n");
					board_led_set(false);
					//gpio_pin_set_dt(&red_led, 1);	
					gpio_pin_set_dt(&green_led, 0);	
					gpio_pin_set_dt(&blue_led, 1);
				} else {
					printk("avg batt\n");
					board_led_set(true);
					//gpio_pin_set_dt(&red_led, 0);	
					gpio_pin_set_dt(&green_led, 0);	
					gpio_pin_set_dt(&blue_led, 1);
				}
				
				k_msleep(5000);
				//gpio_pin_set_dt(&red_led, 1);	
				gpio_pin_set_dt(&green_led, 1);	
				gpio_pin_set_dt(&blue_led, 1);
				board_led_set(false);
				break;	
		}
	}

	onoff.tid = tid;
	onoff.src = ctx->addr;
}

void sensor_status(struct bt_mesh_model *model, struct bt_mesh_msg_ctx *ctx, struct net_buf_simple *buf)
{
	printk("sensor_status\n");
}

void sensor_column_get(struct bt_mesh_model *model, struct bt_mesh_msg_ctx *ctx, struct net_buf_simple *buf)
{
	printk("sensor_column_get\n");
}

void sensor_column_status(struct bt_mesh_model *model, struct bt_mesh_msg_ctx *ctx, struct net_buf_simple *buf)
{
	printk("sensor_column_status\n");
}

void sensor_series_get(struct bt_mesh_model *model, struct bt_mesh_msg_ctx *ctx, struct net_buf_simple *buf)
{
	printk("sensor_series_get\n");
}

void sensor_series_status(struct bt_mesh_model *model, struct bt_mesh_msg_ctx *ctx, struct net_buf_simple *buf)
{
	printk("sensor_series_status\n");
}

//4.2 Sensor messages
const struct bt_mesh_model_op sensor_srv_op[] = {
	{BT_MESH_MODEL_OP_SENSOR_GET, 0, sensor_get},
	{BT_MESH_MODEL_OP_SENSOR_STATUS, 0, sensor_status},
	{BT_MESH_MODEL_OP_SENSOR_COLUMN_GET, 2, sensor_column_get},
	{BT_MESH_MODEL_OP_SENSOR_COLUMN_STATUS, 2, sensor_column_status},
	{BT_MESH_MODEL_OP_SENSOR_SERIES_GET, 2, sensor_series_get},
	{BT_MESH_MODEL_OP_SENSOR_SERIES_STATUS, 2, sensor_series_status},
	BT_MESH_MODEL_OP_END,
};

static struct bt_mesh_model models[] = {
	BT_MESH_MODEL_CFG_SRV,
	BT_MESH_MODEL_HEALTH_SRV(&health_srv, &health_pub),
	BT_MESH_MODEL(BT_MESH_MODEL_ID_SENSOR_SRV, sensor_srv_op, NULL, NULL),
};

static struct bt_mesh_elem elements[] = {
	BT_MESH_ELEM(0, models, BT_MESH_MODEL_NONE),
};

static const struct bt_mesh_comp comp = {
	.cid = BT_COMP_ID_LF,
	.elem = elements,
	.elem_count = ARRAY_SIZE(elements),
};

/* Provisioning */

static uint8_t dev_uuid[16];

static const struct bt_mesh_prov prov = {
	.uuid = dev_uuid,
	// .output_size = 4,
	// .output_actions = BT_MESH_DISPLAY_NUMBER,
	// .output_number = output_number,
	// .complete = prov_complete,
	// .reset = prov_reset,
};

static void configure(void)
{
	int err;
	printk("Configuring...\n");

	/* Add Application Key */
	// err = bt_mesh_cfg_app_key_add(net_idx, addr, net_idx, app_idx, app_key, NULL);
	// if (err) {
	// 	printk("Cfg App key add failed (err: %d)\n", err);
	// 	return;
	// }

	/* Add an application key to both Generic OnOff models: */

	err = bt_mesh_app_key_add(app_idx, net_idx, app_key);
	if (err) {
		printk("Base key add failed (err: %d)\n", err);
		return;
	}

	/* Models must be bound to an app key to send and receive messages with
	 * it:
	 */
	models[2].keys[0] = app_idx;

	printk("Provisioned and configured!\n");

	printk("Configuration complete\n");
}

static int send_sensor_data(struct bt_mesh_model *model, struct bt_mesh_msg_ctx *ctx, uint8_t device, float data)
{
	printk("send_sensor_data()\n");
	if (bt_mesh_is_provisioned()) {
		// struct bt_mesh_msg_ctx ctx = {
		// 	.app_idx = models[2].keys[0], /* Use the bound key */
		// 	.addr = BT_MESH_ADDR_ALL_NODES,
		// 	.send_ttl = BT_MESH_TTL_DEFAULT,
		// };

		static uint8_t tid;

		// if (ctx.app_idx == BT_MESH_KEY_UNUSED) {
		// 	printk("The Generic OnOff Client must be bound to a key before "
		// 		"sending.\n");
		// 	return -ENOENT;
		// }

		BT_MESH_MODEL_BUF_DEFINE(buf, OP_ONOFF_STATUS, 3 + 3 + 4 + 4);
		bt_mesh_model_msg_init(&buf, OP_ONOFF_STATUS);
		net_buf_simple_add_u8(&buf, tid++);
		net_buf_simple_add_u8(&buf, RANDOM_8);
		net_buf_simple_add_u8(&buf, NODE_ADDR);
		net_buf_simple_add_u8(&buf, PREAMBLE);
		net_buf_simple_add_u8(&buf, device);
		net_buf_simple_add_u8(&buf, 4);
		net_buf_simple_add_le32(&buf, timer);
		net_buf_simple_add_le32(&buf, *((uint32_t*)(&data)));

		printk("Sending ");
		for (int i = 0; i < buf.len; i++) {
			printk("%02x ", buf.data[i]);
		}
		printk("\n");
		if (device != BATTERY) {
			printk("Device is not battery\n");
			k_sleep(K_MSEC(100));
			board_led_set(true);
			k_sleep(K_MSEC(50));
			board_led_set(false);
		}
		

		return bt_mesh_model_send(model, ctx, &buf, NULL, NULL);
	}
}

static void bt_ready(int err)
{
	if (err) {
		printk("Bluetooth init failed (err %d)\n", err);
		return;
	}

	printk("Bluetooth initialized\n");

	err = bt_mesh_init(&prov, &comp);
	if (err) {
		printk("Initializing mesh failed (err %d)\n", err);
		return;
	}

	if (IS_ENABLED(CONFIG_SETTINGS)) {
		printk("Loading stored settings\n");
		settings_load();
	}

	err = bt_mesh_provision(net_key, net_idx, flags, iv_index, addr,
				dev_key);
	if (err == -EALREADY) {
		printk("Using stored settings\n");
		configure();
	} else if (err) {
		printk("Provisioning failed (err %d)\n", err);
		return;
	} else {
		printk("Provisioning completed\n");
		configure();
	}

	/* This will be a no-op if settings_load() loaded provisioning info */
	//bt_mesh_prov_enable(BT_MESH_PROV_ADV | BT_MESH_PROV_GATT);

	printk("Mesh initialized\n");
}

void sensors_init (void) 
{
    scu_ccs811_init();
    scu_hts221_init();
    scu_lis2dh_init();
    scu_lps22hb_init();
}    

void main(void)
{
	int err = -1;

	printk("Initializing...\n");

	/*
	srand(time(NULL));
	int r = rand();
	iv_index = r;
	*/

	sensors_init();

	if (IS_ENABLED(CONFIG_HWINFO)) {
		err = hwinfo_get_device_id(dev_uuid, sizeof(dev_uuid));
	}

	if (err < 0) {
		dev_uuid[0] = 0xdd;
		dev_uuid[1] = 0xdd;
	}

	err = board_init();
	if (err) {
		printk("Board init failed (err: %d)\n", err);
	}

	/* Initialize the Bluetooth Subsystem */
	err = bt_enable(bt_ready);
	if (err) {
		printk("Bluetooth init failed (err %d)\n", err);
	}

	int rc = battery_measure_enable(true);

	if (rc != 0) {
		printk("Failed initialize battery measurement: %d\n", rc);
		return;
	}
}
```

## src/board.c
```c
/* board.c - Generic HW interaction hooks */

/*
 * Copyright (c) 2021 Nordic Semiconductor
 *
 * SPDX-License-Identifier: Apache-2.0
 */

#include <bluetooth/mesh.h>
#include <drivers/gpio.h>
#include "board.h"

/* Locate led0 as alias or label by that name */
#if DT_NODE_EXISTS(DT_ALIAS(led0))
#define LED0 DT_ALIAS(led0)
#elif DT_NODE_EXISTS(DT_NODELABEL(led0))
#define LED0 DT_NODELABEL(led0)
#else
#define LED0 DT_INVALID_NODE
#endif

/* Locate button0 as alias or label by sw0 or button0 */
#if DT_NODE_EXISTS(DT_ALIAS(sw0))
#define BUTTON0 DT_ALIAS(sw0)
#elif DT_NODE_EXISTS(DT_ALIAS(button0))
#define BUTTON0 DT_ALIAS(button0)
#elif DT_NODE_EXISTS(DT_NODELABEL(sw0))
#define BUTTON0 DT_NODELABEL(sw0)
#elif DT_NODE_EXISTS(DT_NODELABEL(button0))
#define BUTTON0 DT_NODELABEL(button0)
#else
#define BUTTON0 DT_INVALID_NODE
#endif

#if DT_NODE_EXISTS(LED0)
#define LED0_DEV DT_PHANDLE(LED0, gpios)
#define LED0_PIN DT_PHA(LED0, gpios, pin)
#define LED0_FLAGS DT_PHA(LED0, gpios, flags)

static const struct device *led_dev = DEVICE_DT_GET(LED0_DEV);
#endif /* LED0 */

#if DT_NODE_EXISTS(BUTTON0)
#define BUTTON0_DEV DT_PHANDLE(BUTTON0, gpios)
#define BUTTON0_PIN DT_PHA(BUTTON0, gpios, pin)
#define BUTTON0_FLAGS DT_PHA(BUTTON0, gpios, flags)

static const struct device *button_dev = DEVICE_DT_GET(BUTTON0_DEV);
static struct k_work *button_work;

static void button_cb(const struct device *port, struct gpio_callback *cb,
		      gpio_port_pins_t pins)
{
}
#endif /* BUTTON0 */

static int led_init(void)
{
#if DT_NODE_EXISTS(LED0)
	int err;

	if (!device_is_ready(led_dev)) {
		return -ENODEV;
	}

	err = gpio_pin_configure(led_dev, LED0_PIN,
				 LED0_FLAGS | GPIO_OUTPUT_INACTIVE);
	if (err) {
		return err;
	}
#else
	printk("WARNING: LEDs not supported on this board.\n");
#endif

	return 0;
}

static int button_init(void)
{
#if DT_NODE_EXISTS(BUTTON0)
	int err;

	err = gpio_pin_configure(button_dev, BUTTON0_PIN,
				 BUTTON0_FLAGS | GPIO_INPUT);
	if (err) {
		return err;
	}

	static struct gpio_callback gpio_cb;

	err = gpio_pin_interrupt_configure(button_dev, BUTTON0_PIN,
					   GPIO_INT_EDGE_TO_ACTIVE);
	if (err) {
		return err;
	}

	gpio_init_callback(&gpio_cb, button_cb, BIT(BUTTON0_PIN));
	gpio_add_callback(button_dev, &gpio_cb);
#else
	printk("WARNING: Buttons not supported on this board.\n");
#endif

	return 0;
}

int board_init(void)
{
	int err;

	err = led_init();
	if (err) {
		return err;
	}

	return button_init();
}

void board_led_set(bool val)
{
#if DT_NODE_EXISTS(LED0)
	gpio_pin_set(led_dev, LED0_PIN, val);
#endif
}

void board_output_number(bt_mesh_output_action_t action, uint32_t number)
{
}

void board_prov_complete(void)
{
}
```

## src/scu_sensors.c
```c
/*
***************************************************************
* @file oslib/scu_drivers/scu_sensors/scu_sensors.c
* @author Thanh Do - 45062147
* @date 1/4/2022
***************************************************************
* EXTERNAL FUNCTIONS
***************************************************************
* int scu_ccs811_init(void)
* double scu_ccs811_read(void)
* int scu_hts221_init(void)
* double scu_hts221_read_temp(void)
* double scu_hts221_read_hum(void)
* int scu_lis2dh_init(void)
* double scu_lis2dh_read(int axis)
* int scu_lps22hb_init(void)
* double scu_lps22hb_read(void)
***************************************************************
*/

#include <zephyr.h>
#include <device.h>
#include <drivers/sensor.h>
#include <sys/printk.h>
#include <drivers/sensor/ccs811.h>
#include <stdio.h>
#include <sys/util.h>
#include <stdint.h>

static bool app_fw_2;

// Device structures for sensors
const struct device *ccs811_dev;
const struct device *hts221_dev;
const struct device *lis2dh_dev;
const struct device *lps22hb_dev;

/**
 * @brief  reads CCS811 sensor value
 * 
 * @return returns CCS811 sensor value
**/
double scu_ccs811_read_voc(void)
{
	static struct sensor_value tvoc;
	int rc = 0;

	if (rc == 0) {
		rc = sensor_sample_fetch(ccs811_dev);
	}
	
	if (rc == 0) {
		const struct ccs811_result_type *rp = ccs811_result(ccs811_dev);

		sensor_channel_get(ccs811_dev, SENSOR_CHAN_VOC, &tvoc);

		if (app_fw_2 && !(rp->status & CCS811_STATUS_DATA_READY)) {
			printk("STALE DATA\n");
		}

		if (rp->status & CCS811_STATUS_ERROR) {
			printk("ERROR: %02x\n", rp->error);
		}
	}

	if (rc == 0) {
		printk("Timed fetch got %d\n", rc);
	} else if (-EAGAIN == rc) {
		printk("Timed fetch got stale data\n");
	} else {
		printk("Timed fetch failed: %d\n", rc);
	}
	
	return (double) tvoc.val1;
}

/**
 * @brief  reads CCS811 sensor value
 * 
 * @return returns CCS811 sensor value
**/
double scu_ccs811_read_eco2(void)
{
	static struct sensor_value eco2;
	int rc = 0;

	if (rc == 0) {
		rc = sensor_sample_fetch(ccs811_dev);
	}
	
	if (rc == 0) {
		const struct ccs811_result_type *rp = ccs811_result(ccs811_dev);

		sensor_channel_get(ccs811_dev, SENSOR_CHAN_CO2, &eco2);

		if (app_fw_2 && !(rp->status & CCS811_STATUS_DATA_READY)) {
			printk("STALE DATA\n");
		}

		if (rp->status & CCS811_STATUS_ERROR) {
			printk("ERROR: %02x\n", rp->error);
		}
	}

	if (rc == 0) {
		printk("Timed fetch got %d\n", rc);
	} else if (-EAGAIN == rc) {
		printk("Timed fetch got stale data\n");
	} else {
		printk("Timed fetch failed: %d\n", rc);
	}
	
	return (double) eco2.val1;
}

/**
 * @brief  Initilise CCS811 sensor
 * 
 * @return error status
**/
int scu_ccs811_init(void)
{
	ccs811_dev = device_get_binding(DT_LABEL(DT_INST(0, ams_ccs811)));
	struct ccs811_configver_type cfgver;
	int rc;

	if (!ccs811_dev) {
		printk("Failed to get device binding");
		return -1;
	}

	printk("device is %p, name is %s\n", ccs811_dev, ccs811_dev->name);

	rc = ccs811_configver_fetch(ccs811_dev, &cfgver);

	if (rc == 0) {
		printk("HW %02x; FW Boot %04x App %04x ; mode %02x\n",
		       cfgver.hw_version, cfgver.fw_boot_version,
		       cfgver.fw_app_version, cfgver.mode);
		app_fw_2 = (cfgver.fw_app_version >> 8) > 0x11;
	}

    return 0;
}

/**
 * @brief  reads HTS221 temperature sensor value
 * 
 * @return returns HTS221 temperature sensor value
**/
double scu_hts221_read_temp(void)
{
	static struct sensor_value temp;

	if (sensor_sample_fetch(hts221_dev) < 0) {
		printf("Sensor sample update errortemp\n");
		return -1;
	}

	if (sensor_channel_get(hts221_dev, SENSOR_CHAN_AMBIENT_TEMP, &temp) < 0) {
		printf("Cannot read HTS221 temperature channel\n");
		return -1;
	}
    return sensor_value_to_double(&temp);
}

/**
 * @brief  reads HTS221 humidity sensor value
 * 
 * @return returns HTS221 humidity sensor value
**/
double scu_hts221_read_hum(void) 
{
	static struct sensor_value hum;

	if (sensor_sample_fetch(hts221_dev) < 0) {
		printf("Sensor sample update errorhum\n");
		return -1;
	}

	if (sensor_channel_get(hts221_dev, SENSOR_CHAN_HUMIDITY, &hum) < 0) {
		printf("Cannot read HTS221 humidity channel\n");
		return -1;
	}

    return sensor_value_to_double(&hum);
}

/**
 * @brief  Initilise HTS221 sensor
 * 
 * @return error status
**/
int scu_hts221_init(void)
{
    hts221_dev = device_get_binding("HTS221");

	if (hts221_dev == NULL) {
		printf("Could not get HTS221 device\n");
		return -1;
	}

    return 0;
}

/**
 * @brief  reads LIS2DH accelleration sensor value
 * 
 * @param axis Selects which axis to return
 * @return returns LIS2DH accelleration sensor value for selected axis
**/
double scu_lis2dh_read(int axis)
{
	struct sensor_value accel[3];
	const char *overrun = "";
	int rc = sensor_sample_fetch(lis2dh_dev);

	if (rc == -EBADMSG) {
		/* Sample overrun.  Ignore in polled mode. */
		if (IS_ENABLED(CONFIG_LIS2DH_TRIGGER)) {
			overrun = "[OVERRUN] ";
		}
		rc = 0;
	}

	if (rc == 0) {
		rc = sensor_channel_get(lis2dh_dev,
					SENSOR_CHAN_ACCEL_XYZ,
					accel);
	}

	if (rc < 0) {
		printf("ERROR: Update failed: %d\n", rc);
        return -1;
	} else {
		return sensor_value_to_double(&accel[axis]);
	}
}

/**
 * @brief  Initilise LIS2DH sensor
 * 
 * @return error status
**/
int scu_lis2dh_init(void)
{
	lis2dh_dev = DEVICE_DT_GET_ANY(st_lis2dh);

	if (lis2dh_dev == NULL) {
		printf("No device found\n");
		return -1;
	}

	if (!device_is_ready(lis2dh_dev)) {
		printf("Device %s is not ready\n", lis2dh_dev->name);
		return -1;
	}
    
    return 0;
}

/**
 * @brief  reads LPS22HB pressure sensor value
 * 
 * @return returns LPS22HB pressure sensor value
**/
double scu_lps22hb_read(void)
{
	static struct sensor_value pressure;

	if (sensor_sample_fetch(lps22hb_dev) < 0) {
		printf("Sensor sample update errorpress\n");
		return -1;
	}

	if (sensor_channel_get(lps22hb_dev, SENSOR_CHAN_PRESS, &pressure) < 0) {
		printf("Cannot read LPS22HB pressure channel\n");
		return -1;
	}

    return sensor_value_to_double(&pressure);
}

/**
 * @brief  Initilise LPS22HB sensor
 * 
 * @return error status
**/
int scu_lps22hb_init(void)
{
	lps22hb_dev = device_get_binding(DT_LABEL(DT_INST(0, st_lps22hb_press)));

	if (lps22hb_dev == NULL) {
		printf("Could not get LPS22HB device\n");
		return -1;
	}

    return 0;
}
```

## src/scu_sensors.h
```c
#ifndef SCU_SENSORS_H
#define SCU_SENSORS_H

int scu_ccs811_init(void);
double scu_ccs811_read_voc(void);
double scu_ccs811_read_eco2(void);
int scu_hts221_init(void);
double scu_hts221_read_temp(void);
double scu_hts221_read_hum(void);
int scu_lis2dh_init(void);
double scu_lis2dh_read(int axis);
int scu_lps22hb_init(void);
double scu_lps22hb_read(void);
#endif
```
